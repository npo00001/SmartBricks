 #include <bluefruit.h>
 #include <Adafruit_MAX31856.h>

#define THERMOCOUPLE_CS 10
#define SLEEP_TIME 5000 // ms sleep duration 
#define BROADCAST_DURATION  1500 // ms Time to make data available via Bluetooth
#define CIRCUIT_DELAY 500 //amount of time to leave the circuit powered before taking a sample

#define DATA_LENGTH 25 // Length of String sent over Bluetooth (includes \0)
#define ADC_RESOLUTION 14 //can be 8, 10, 12, 14 

#define POWER 6 //LOW turns power off HIGH keeps it on

#define ANALOG_VALUE_SCALE A0 //ouput of circuit (analog)
#define VBAT A6 //output voltage of the attached battery

// Define circuit rail voltages
#define SAMPLES_PER_READING 5000

const int numEntries = 1201;  // Number of entries in the lookup table
float inputValues [numEntries] = {0,1,2,3,4,5,6,7,8,9,10,11,12,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 1199, 1200};
float outputValues [numEntries] = {0.000,0.039,0.079,0.119,0.158,0.198,0.238,0.277,0.317,0.357,0.397,0.437,0.477,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48.802,48.838};



char UUID[37] = "01000100-0100-1111-0100-0101ffD0E001";
char data[DATA_LENGTH] = "NoData";
int currentRange = 0;

BLEService sensorService = BLEService(UUID);
BLECharacteristic sensorCharacteristic = BLECharacteristic(0x1235);

BLEDis bledis; //device information serive (Model, Manufacturer,...)



Adafruit_MAX31856 maxthermo = Adafruit_MAX31856(THERMOCOUPLE_CS);

String my_ans;

void setup()
{
  Serial.begin(9600);
  // put your setup code here, to run once:
  maxthermo.begin();
  maxthermo.setThermocoupleType(MAX31856_TCTYPE_K);
  switch (maxthermo.getThermocoupleType() ) {
    case MAX31856_TCTYPE_B: my_ans="B"; break;
    case MAX31856_TCTYPE_E: my_ans="E"; break;
    case MAX31856_TCTYPE_J: my_ans="J"; break;
    case MAX31856_TCTYPE_K: my_ans="K"; break;
    case MAX31856_TCTYPE_N: my_ans="N"; break;
    case MAX31856_TCTYPE_R: my_ans="R"; break;
    case MAX31856_TCTYPE_S: my_ans="S"; break;
    case MAX31856_TCTYPE_T: my_ans="T"; break;
    case MAX31856_VMODE_G8: my_ans="No"; break;
    case MAX31856_VMODE_G32: my_ans="No"; break;
    default: my_ans="?"; break;
  }
  Bluefruit.begin();

  Bluefruit.Periph.setConnectCallback(connect_callback); //set ISR for when connection is made
  Bluefruit.Periph.setDisconnectCallback(disconnect_callback); //set ISR for when disconnection occurs

  //device information
  bledis.setManufacturer("Adafruit Industries");
  bledis.setModel("Bluefruit Feather52");
  bledis.begin();

  setupService();
  startAdv();

  //set digital pins as outputs
  
  pinMode(POWER, OUTPUT);

  // Set starting range

  digitalWrite(POWER, LOW);

  analogReadResolution(ADC_RESOLUTION); //determines ADC resolution
  analogReference(AR_VDD4); //set reference voltage equal to VDD (3.3V)

  //turn off LEDs
  digitalWrite(LED_BLUE, LOW);
  digitalWrite(LED_RED, LOW);
  //digitalWrite(PIN_NEOPIXEL, LOW);

}

void setupService(void) {
  sensorService.begin();
  sensorCharacteristic.setFixedLen(DATA_LENGTH);  //sets data length of data to send
  sensorCharacteristic.setProperties(CHR_PROPS_READ); //allows characteristic to be read
  sensorCharacteristic.setPermission(SECMODE_OPEN, SECMODE_OPEN); //(read, write) can read and write

  //Calling .begin on a characteristic will add it to the last service that had .begin called on it
  sensorCharacteristic.begin();
}

void startAdv(void) {
  // Advertising packet
  Bluefruit.Advertising.addFlags(BLE_GAP_ADV_FLAGS_LE_ONLY_GENERAL_DISC_MODE);
  Bluefruit.Advertising.addTxPower();

  // Include HRM Service UUID
  Bluefruit.Advertising.addService(sensorService);

  // Include Name
  Bluefruit.Advertising.addName();

  Bluefruit.Advertising.restartOnDisconnect(false); //false = do not resume advertising after disconnect
  Bluefruit.Advertising.setInterval(32, 244);  //Advertising intervals (fast, slow) (must be specific values)
}

void connect_callback(uint16_t conn_handle)
{
  digitalWrite(LED_BLUE, LOW); //turn off connection LED

  // Read log voltage
  digitalWrite(POWER, HIGH);
  float measLog = 0;

  //read wheatstone voltage
  delay(CIRCUIT_DELAY);
  float Analog_Volt_Value = (readVoltageAvg(SAMPLES_PER_READING, ANALOG_VALUE_SCALE))*100;
  Serial.println(data);
  float thermocoupleTemp = maxthermo.readCJTemperature();
  //Serial.println(thermocoupleTemp,5);

  int lowerIdx = 0;
  int upperIdx = numEntries - 1;

  for (int i = 1; i < numEntries; i++) {
    if (thermocoupleTemp <= inputValues[i]) {
      upperIdx = i;
      break;
      }
      lowerIdx = i;
  }
  float lowerOutput = outputValues[lowerIdx];
  float upperOutput = outputValues[upperIdx];

  float averageOutput = (lowerOutput + upperOutput) / 2;

  float modified_analog_voltage = Analog_Volt_Value + averageOutput;

  int lowerIdx2 = 0;
  int upperIdx2 = numEntries - 1;

  for (int i = 1; i < numEntries; i++) {
    if (modified_analog_voltage <= outputValues[i]) {
      upperIdx2 = i;
      break;
      }
      lowerIdx2 = i;
  }
  float lowerOutput2 = inputValues[lowerIdx2];
  float upperOutput2 = inputValues[upperIdx2];

  float average_temp = (lowerOutput2 + upperOutput2) / 2;
  float Actual_Thermocouple_Temp = maxthermo.readThermocoupleTemperature();

  //read battery voltage
  float measVBat = getBatV(SAMPLES_PER_READING);
  digitalWrite(POWER, LOW);

  float error1 = ((Actual_Thermocouple_Temp-average_temp)/Actual_Thermocouple_Temp)*100;

  //write data to characteristic
  snprintf(data, DATA_LENGTH, "%.2f %.1f %.1f %.5f", Analog_Volt_Value, average_temp, Actual_Thermocouple_Temp, thermocoupleTemp);
  sensorCharacteristic.write(data);
  //Serial.print(data);  

  // Get the reference to current connection
  BLEConnection* connection = Bluefruit.Connection(conn_handle);
}
void disconnect_callback(uint16_t conn_handle, uint8_t reason) {
  //stop advertising and go to sleep
  Bluefruit.Advertising.stop();
  delay(SLEEP_TIME);
}

void loop()
{
  if (!Bluefruit.connected()) {
    Bluefruit.Advertising.start(BROADCAST_DURATION); //stops broadcasting after BROADCOST_DURATION ms
    unsigned long start_time = millis();

    //stop broadcasting if connection is made
    while (millis() - start_time <=  BROADCAST_DURATION) {
      if (Bluefruit.connected()) {
        break;
      }
    }

    //stop advertising and go to sleep if no central picked up data in time
    Bluefruit.Advertising.stop();
    delay(SLEEP_TIME); //delay is sleep
  }
}



// Read the voltage at pin ANALOG_VALUE_SCALE as an average of numSamples number of points
float readVoltageAvg(int numSamples, int analogPin)
{
  delay(100);

  // Sum numSamples readings
  long total = 0;
  for (int i = 0; i < numSamples; i++)
    total += analogRead(analogPin);

  // Compute voltage from average of readings
  float average = (float) total / (float) numSamples;
  float voltage = average * (3.3 / (float)(pow(2, ADC_RESOLUTION) - 1));

  return voltage;
}

float getBatV(int numSamples) {
  //4.2 volts is full and 3.2 is empty

  long total = 0;
  for (int i = 0; i < numSamples; i++)
    total += analogRead(VBAT);
  
  float measuredvbat = (float) total / (float)numSamples;
  measuredvbat *= 2.0;    // we divided by 2, so multiply back
  measuredvbat *= 3.3;  // Multiply by 3.3V, our reference voltage
  measuredvbat /= (pow(2, ADC_RESOLUTION) - 1); // convert to voltage

  return measuredvbat;
}
