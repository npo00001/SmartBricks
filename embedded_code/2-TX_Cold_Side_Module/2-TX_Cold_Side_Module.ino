#include <bluefruit.h>
#include <Adafruit_MAX31856.h>

// Pin assignments
#define THERMOCOUPLE_CS 10  // Chip select pin for the MAX31856 thermocouple
#define POWER 6  // Controls power to the circuit (LOW = off, HIGH = on)
#define ANALOG_VALUE_SCALE A0  // Analog output of the circuit
#define VBAT A6  // Battery voltage measurement pin

// Timing configurations (in milliseconds)
#define SLEEP_TIME 20000  // Time to sleep before transmitting data
#define BROADCAST_DURATION 1500  // Duration for making data available via Bluetooth
#define CIRCUIT_DELAY 500  // Delay before taking a sample after powering the circuit

// ADC settings
#define ADC_RESOLUTION 14  // ADC resolution (options: 8, 10, 12, 14 bits)
#define SAMPLES_PER_READING 5000  // Number of samples for averaging voltage readings

// Bluetooth data settings
#define DATA_LENGTH 25  // Length of string sent over Bluetooth (including null terminator)

// Analog to voltage lookup table
const int numEntries = 1649;  // Number of entries in the lookup table
float inputValues [numEntries] = {-0.015, -0.014, -0.013, -0.012, -0.011, -0.01, -0.00900000000000001, -0.00800000000000001, -0.00700000000000001, -0.00600000000000001, -0.00500000000000001, -0.004, -0.003,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 3.197, 3.199};
float outputValues [numEntries] = {-0.45, -0.44, -0.43, -0.42, -0.41, -0.4, -0.39, -0.38, -0.37, -0.36, -0.35, -0.34, -0.33,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 1565, 1566};

// Bluetooth UUID and data buffer
char UUID[37] = "01000100-0100-1111-0100-0101ffD0E004"; // Unique Bluetooth UUID for the service
char data[DATA_LENGTH] = "NoData"; // Placeholder data to be sent via Bluetooth
int currentRange = 0; // Stores the current range value

// Bluetooth service and characteristic
BLEService sensorService = BLEService(UUID);
BLECharacteristic sensorCharacteristic = BLECharacteristic(0x1235);
BLEDis bledis; //device information serive (Model, Manufacturer,...)
Adafruit_MAX31856 maxthermo = Adafruit_MAX31856(THERMOCOUPLE_CS);

String my_ans;

void setup()
{
  // Initialize thermocouple sensor
  maxthermo.begin();
  maxthermo.setThermocoupleType(MAX31856_TCTYPE_K);

  // Identify thermocouple type
  switch (maxthermo.getThermocoupleType() ) {
    case MAX31856_TCTYPE_B: my_ans="B"; break;
    case MAX31856_TCTYPE_E: my_ans="E"; break;
    case MAX31856_TCTYPE_J: my_ans="J"; break;
    case MAX31856_TCTYPE_K: my_ans="K"; break;
    case MAX31856_TCTYPE_N: my_ans="N"; break;
    case MAX31856_TCTYPE_R: my_ans="R"; break;
    case MAX31856_TCTYPE_S: my_ans="S"; break;
    case MAX31856_TCTYPE_T: my_ans="T"; break;
    case MAX31856_VMODE_G8: my_ans="No"; break;
    case MAX31856_VMODE_G32: my_ans="No"; break;
    default: my_ans="?"; break;
  }

  // Initialize Bluetooth
  Bluefruit.begin();
  Bluefruit.Periph.setConnectCallback(connect_callback); //set ISR for when connection is made
  Bluefruit.Periph.setDisconnectCallback(disconnect_callback); //set ISR for when disconnection occurs

  // Set device information
  bledis.setManufacturer("Adafruit Industries");
  bledis.setModel("Bluefruit Feather52");
  bledis.begin();

  setupService();
  startAdv();

  //set digital pins as outputs
  pinMode(POWER, OUTPUT);

  // Initially power off the circuit
  digitalWrite(POWER, LOW);

  // Set starting range for analog readings
  analogReadResolution(ADC_RESOLUTION); // Set starting range for analog readings
  analogReference(AR_VDD4); // Set reference voltage equal to VDD (3.3V)

  //turn off LEDs (if present)
  digitalWrite(LED_BLUE, LOW);
  digitalWrite(LED_RED, LOW);
  //digitalWrite(PIN_NEOPIXEL, LOW);

}

void setupService(void) {
  // Initialize the sensor service
  sensorService.begin();

  // Configure the sensor characteristic (fixed length data)
  sensorCharacteristic.setFixedLen(DATA_LENGTH); // sets data length of data to send
  sensorCharacteristic.setProperties(CHR_PROPS_READ); // Make characteristic readable
  sensorCharacteristic.setPermission(SECMODE_OPEN, SECMODE_OPEN); // Open for read/write

  // Add the characteristic to the service
  sensorCharacteristic.begin();
}

void startAdv(void) {
  // Start advertising the Bluetooth service with the required flags
  Bluefruit.Advertising.addFlags(BLE_GAP_ADV_FLAGS_LE_ONLY_GENERAL_DISC_MODE);
  Bluefruit.Advertising.addTxPower(); // Add transmit power info to advertisement

  // Add the sensor service to the advertisement
  Bluefruit.Advertising.addService(sensorService);

  // Include device name in the advertisement
  Bluefruit.Advertising.addName();

  // Configure advertising behavior
  Bluefruit.Advertising.restartOnDisconnect(false); // Don't resume advertising after disconnection
  Bluefruit.Advertising.setInterval(32, 244); // Advertising intervals (fast and slow)
}

void connect_callback(uint16_t conn_handle)
{
  digitalWrite(LED_BLUE, LOW); // Turn off the LED when connected

  // Read and measure voltages
  digitalWrite(POWER, HIGH); // Power on the circuit
  float measLog = 0;

  // Delay before reading the Wheatstone bridge voltage
  delay(CIRCUIT_DELAY);
  float Analog_Volt_Value = 0; // Why is this zero?

  // Find the closest input values to determine the output
  int lowerIdx = 0;
  int upperIdx = numEntries - 1;

  for (int i = 1; i < numEntries; i++) {
    if (Analog_Volt_Value <= inputValues[i]) {
      upperIdx = i;
      break;
      }
      lowerIdx = i;
  }

  // Interpolate between the closest values
  float lowerOutput = outputValues[lowerIdx];
  float upperOutput = outputValues[upperIdx];
  float averageOutput = (lowerOutput + upperOutput) / 2;

  // Measure battery voltage
  float measVBat = getBatV(SAMPLES_PER_READING);

  // Read thermocouple temperature
  float thermocoupleTemp = maxthermo.readThermocoupleTemperature();

  digitalWrite(POWER, LOW); // Power off the circuit

  // Prepare data to be sent over Bluetooth
  snprintf(data, DATA_LENGTH, "%.5f %d %.1f %.5f", Analog_Volt_Value, currentRange, thermocoupleTemp, measVBat);
  sensorCharacteristic.write(data); // Write data to Bluetooth characteristic
  //Serial.print(data);  

  // Get the reference to current connection
  BLEConnection* connection = Bluefruit.Connection(conn_handle);
}

void disconnect_callback(uint16_t conn_handle, uint8_t reason) {
  // Stop advertising when disconnected
  Bluefruit.Advertising.stop();
  delay(SLEEP_TIME); // Sleep for a period before attempting to advertise again
}

void loop()
{
  // If not connected, start advertising
  if (!Bluefruit.connected()) {
    Bluefruit.Advertising.start(BROADCAST_DURATION); // Start advertising for a set duration
    unsigned long start_time = millis();

    // Stop advertising if a connection is made within the time limit
    while (millis() - start_time <=  BROADCAST_DURATION) {
      if (Bluefruit.connected()) {
        break;
      }
    }

    // Stop advertising and go to sleep if no central device connects in time
    Bluefruit.Advertising.stop();
    delay(SLEEP_TIME); // Sleep before trying to advertise again
  }
}

// Read the voltage at pin 'analogPin' and return the average value
float readVoltageAvg(int numSamples, int analogPin)
{
  delay(100); // Short delay before starting the read

  // Sum the values of 'numSamples' readings from the analog pin
  long total = 0;
  for (int i = 0; i < numSamples; i++)
    total += analogRead(analogPin);

  // Compute the average voltage from the readings
  float average = (float) total / (float) numSamples;
  float voltage = average * (3.3 / (float)(pow(2, ADC_RESOLUTION) - 1)); // Convert to voltage using reference voltage

  return voltage;
}

// Measure and return the battery voltage
float getBatV(int numSamples) {
  // Assume 4.2V is full and 3.2V is empty for a typical Li-ion battery

  long total = 0;
  for (int i = 0; i < numSamples; i++)
    total += analogRead(VBAT); // Read battery voltage pin
  
  float measuredvbat = (float) total / (float)numSamples;
  measuredvbat *= 2.0;    // The value is halved internally, so multiply by 2
  measuredvbat *= 3.3;    // Multiply by reference voltage (3.3V)
  measuredvbat /= (pow(2, ADC_RESOLUTION) - 1); // Convert to actual voltage

  return measuredvbat;
}
